## src/Kconfig.projbuild
```kconfig
menu "wifi-tool"

  menu "AP"

    config WIFI_AP_SSID
      string "SSID"
      default "ssid"

    config WIFI_AP_PASSWORD
      string "Password"

    config WIFI_AP_CHANNEL
      int "Channel"
      range 1 14
      default 1

    choice WIFI_AP_AUTHMODE
      prompt "Authmode"
      default WIFI_AUTH_OPEN


      config WIFI_AUTH_OPEN
        bool "Open"
      config WIFI_AUTH_WEB
        bool "WEB"
      config WIFI_AUTH_WPA_PSK
        bool "WPA_PSK"
      config WIFI_AUTH_WPA2_PSK
        bool "WPA2_PSK"
      config WIFI_AUTH_WPA_WPA2_PSK
        bool "WPA_WPA2_PSK"
      config WIFI_AUTH_WPA2_ENTERPRISE
        bool "WPA2_ENTERPRISE"
      config WIFI_AUTH_WPA3_PSK
        bool "WPA3_PSK"
      config WIFI_AUTH_WPA2_WPA3_PSK
        bool "WPA2_WPA3_PSK"
      config WIFI_AUTH_WAPI_PSK
        bool "WAPI_PSK"
      config WIFI_AUTH_OWE
        bool "OWE"
    endchoice

    config WIFI_AP_MAX_CONNECTION
      int "Max connection"
      default 1

    menu "Ip"

      config WIFI_AP_IP_A
        int "a"
        range 0 255
        default 192

      config WIFI_AP_IP_B
        int "b"
        range 0 255
        default 168

      config WIFI_AP_IP_C
        int "c"
        range 0 255
        default 4

      config WIFI_AP_IP_D
        int "d"
        range 0 255
        default 1

    endmenu

  endmenu

endmenu
```
